//-----------------------------------------------------------------------------
// F350_ADC0_ExternalInput.c
//-----------------------------------------------------------------------------
// 程序说明：
//   使用 C8051F350 的 24 位 Sigma-Delta ADC0 从 AIN0.0 单端采集电压（对 AGND），
//   每 16 次转换求平均后通过 UART0 打印测量结果（mV）。
//
// 硬件连接：
//   - AIN0.0 接被测电压（0 ~ 2.5V，使用内部 2.5V 基准）
//   - P0.4  UART TX（9600bps）
//   - P0.5  UART RX
//   - P1.3  LED（推挽输出，用于指示测量更新；学习板上的 LED 即接在此引脚）
//
// 说明：
//   F350 的 ADC0 是 24 位 Sigma-Delta ADC，与 F330 的 10 位 SAR ADC 完全不同。
//   本代码使用内部 2.5V 基准、连续转换模式、SINC3 滤波器，PGA 增益 = 1。
//   寄存器用法参照 Silabs 官方例程 F35x_ADC0_ExternalInput.c
//   （资料目录：04_全部例程/C8051F35x/ADC/）。
//-----------------------------------------------------------------------------

#include <c8051f350.h>                 // SFR 声明
#include <stdio.h>

//-----------------------------------------------------------------------------
// 全局常量
//-----------------------------------------------------------------------------
#define SYSCLK       24500000          // 系统时钟频率 24.5MHz
#define BAUDRATE     9600              // UART 波特率（与之前的例程一致；改这一行即可换波特率）
#define AVERAGE_TIMES 16               // 平均次数（输出字速率约 10Hz，即约 1.6 秒打印一次）

sbit LED = P1^3;                       // LED 指示灯

//-----------------------------------------------------------------------------
// 函数原型
//-----------------------------------------------------------------------------
void SYSCLK_Init (void);
void PORT_Init (void);
void UART0_Init (void);
void ADC0_Init (void);
char putchar (char c);

//-----------------------------------------------------------------------------
// 主程序
//-----------------------------------------------------------------------------
void main (void)
{
    PCA0MD &= ~0x40;                   // 关闭看门狗

    SYSCLK_Init ();                    // 初始化系统时钟 24.5MHz
    PORT_Init ();                      // 初始化端口和交叉开关
    UART0_Init ();                     // 初始化 UART0
    ADC0_Init ();                      // 初始化 ADC0（含内部全校准，结束时处于 IDLE）

    printf("F350 ADC0 ready. [build 1014]\r\n");    // 上电自检输出（含版本标记，便于对照固件版本）

    AD0INT = 0;                        // 清除可能挂起的转换完成标志
    ADC0MD = 0x83;                     // AD0EN=1，AD0SM[2:0]=011 → 启动连续转换
    EA = 1;                            // 使能全局中断

    while (1) {
        // 主循环空闲；采样、平均、打印全部在 ADC0 中断中完成
    }
}

//-----------------------------------------------------------------------------
// SYSCLK_Init
//-----------------------------------------------------------------------------
void SYSCLK_Init (void)
{
    OSCICN = 0x83;                     // 内部振荡器 24.5MHz，不分频
    RSTSRC = 0x04;                     // 使能缺失时钟检测
}

//-----------------------------------------------------------------------------
// PORT_Init
//-----------------------------------------------------------------------------
// 配置交叉开关和 GPIO：
//   P0.4 - UART TX（推挽）
//   P0.5 - UART RX
//   P1.3 - LED（推挽）
// 注意：AIN0.0 是专用模拟输入引脚，无需配置端口寄存器。
//-----------------------------------------------------------------------------
void PORT_Init (void)
{
    XBR0 = 0x01;                       // 使能 UART0 到 P0.4/P0.5
    XBR1 = 0x40;                       // 使能交叉开关和弱上拉
    P0MDOUT |= 0x10;                   // P0.4 推挽输出
    P1MDOUT |= 0x08;                   // P1.3 推挽输出（LED）
}

//-----------------------------------------------------------------------------
// UART0_Init
//-----------------------------------------------------------------------------
// 配置 UART0：8 位 UART（模式 1），使能接收，波特率 9600。
// Timer1 作为波特率发生器。以下自适应写法与官方例程一致：
// 修改 BAUDRATE 后会自动选择合适的时钟源和重载值。
//-----------------------------------------------------------------------------
void UART0_Init (void)
{
    SCON0 = 0x10;                      // 8位UART（模式1），使能接收，清 RI0/TI0

    // 根据波特率自动选择合适的 Timer1 时钟源和重载值
    // （官方例程同款算法；用 #if 在编译期选择，避免产生"不可达代码"警告）
#if (SYSCLK/BAUDRATE/2/256 < 1)
    TH1 = -(SYSCLK/BAUDRATE/2);
    CKCON |=  0x08;                    // T1M = 1，Timer1 使用 SYSCLK
#elif (SYSCLK/BAUDRATE/2/256 < 4)
    TH1 = -(SYSCLK/BAUDRATE/2/4);
    CKCON &= ~0x0B;                    // T1M = 0，SCA1:0 = 01
    CKCON |=  0x01;
#elif (SYSCLK/BAUDRATE/2/256 < 12)
    TH1 = -(SYSCLK/BAUDRATE/2/12);
    CKCON &= ~0x0B;                    // T1M = 0，SCA1:0 = 00（Timer1 用 SYSCLK/12）
#else
    TH1 = -(SYSCLK/BAUDRATE/2/48);
    CKCON &= ~0x0B;                    // T1M = 0，SCA1:0 = 10
    CKCON |=  0x02;
#endif

    TL1 = TH1;                         // 初始化 Timer1 重载值
    TMOD &= ~0xF0;                     // Timer1：8 位自动重载（方式 2）
    TMOD |=  0x20;
    TR1 = 1;                           // 启动 Timer1
    TI0 = 0;                           // 清发送标志（保证每个字符都等待真实发送完成，避免首行丢字符）
}

//-----------------------------------------------------------------------------
// putchar
//-----------------------------------------------------------------------------
// 重定向 printf 输出到 UART0。
//-----------------------------------------------------------------------------
char putchar (char c)
{
    SBUF0 = c;
    while (!TI0);                      // 等待发送完成
    TI0 = 0;                           // 清除发送标志
    return c;
}

//-----------------------------------------------------------------------------
// ADC0_Init
//-----------------------------------------------------------------------------
// 配置 ADC0（顺序参照官方例程）：
//   - 内部 2.5V 基准
//   - 单端输入：AIN0.0 为正输入，AGND 为负输入（ADC0MUX = 0x08）
//   - 调制器时钟 MDCLK ≈ 2.45MHz（ADC0CLK = 9）
//   - 抽取比 1920 → 输出字速率约 10Hz
//   - PGA 增益 = 1，单极性
//   - 执行内部全校准（ADC0MD = 0x81，等待 AD0CALC 置位）
//   - 校准后进入 IDLE 模式（ADC0MD = 0x80），转换由 main 启动
//
// 【重要】AD0SM 模式位在 ADC0MD 的【低 3 位】（不是高 3 位！）：
//   000 = 空闲(IDLE)   001 = 内部全校准   011 = 连续转换
//-----------------------------------------------------------------------------
void ADC0_Init (void)
{
    REF0CN = 0x03;                     // 使能内部基准和偏置（BIASE=1, REFBE=1）

    ADC0MUX = 0x08;                    // 正输入 = AIN0.0(0000)，负输入 = AGND(1000) → 单端

    ADC0CN = 0x00;                     // PGA 增益 = 1，单极性

    ADC0CF = 0x00;                     // 中断源 = SINC3 滤波器输出，基准 = 内部

    ADC0CLK = 9;                       // MDCLK = SYSCLK/(9+1) = 2.45MHz（理想 2.4576MHz）

    ADC0DECH = 0x07;                   // 抽取比 = DECI+1 = 0x77F+1 = 1920
    ADC0DECL = 0x7F;                   // 输出字速率 = MDCLK/(128×1920) ≈ 9.97Hz

    ADC0BUF = 0x00;                    // 关闭输入缓冲

    ADC0MD = 0x81;                     // AD0EN=1，AD0SM=001 → 启动内部全校准
    while (!AD0CALC);                  // 等待校准完成（AD0CALC = ADC0STA.2）

    EIE1 |= 0x08;                      // 使能 ADC0 转换结束中断（EADC0C）

    ADC0MD = 0x80;                     // AD0EN=1，AD0SM=000 → IDLE（等待 main 启动转换）
}

//-----------------------------------------------------------------------------
// ADC0_ISR
//-----------------------------------------------------------------------------
// ADC0 转换完成中断服务程序（中断向量 10）。每次转换完成后读取 24 位
// 结果并累加，累计 AVERAGE_TIMES 次后求平均，换算为电压（mV）打印。
//-----------------------------------------------------------------------------
void ADC0_ISR (void) interrupt 10
{
    static unsigned long accumulator = 0;          // 累加器
    static unsigned int  count = AVERAGE_TIMES;    // 计数
    unsigned long adc_value;
    unsigned long result;
    unsigned long mV;

    while (!AD0INT);                   // 等待转换完成标志置位（与官方例程一致，防临界情况）
    AD0INT = 0;                        // 清除转换完成标志

    // 读取 24 位 SINC3 结果（ADC0H/M/L，单极性）
    adc_value = ((unsigned long)ADC0H << 16) |
                ((unsigned long)ADC0M << 8)  |
                ((unsigned long)ADC0L);

    accumulator += adc_value;
    count--;

    if (count == 0)
    {
        count = AVERAGE_TIMES;
        result = accumulator / AVERAGE_TIMES;
        accumulator = 0;

        // 单极性输出：0x000000 对应 0V，0xFFFFFF 对应 VREF = 2.5V
        // mV = result × 2500 / (2^24 - 1) ≈ result / 6710
        // （官方例程同款整数算法，避免引入浮点库、节省 Flash）
        mV = result / 6710;

        printf("ADC voltage: %lu mV [raw %lu]\n", mV, result);
        LED = !LED;                    // 翻转 LED，指示更新
    }
}

//-----------------------------------------------------------------------------
// 文件结束
//-----------------------------------------------------------------------------
