/* ============================================================================
 *  Lab 1 — GPIO 输出与"上电安全态"
 * ============================================================================
 *  文件：firmware/labs/Lab1_GPIO/lab1_gpio.c
 *
 *  目标：
 *    (1) 把 PA0 / PA1 / PA2 / PA3 配置为推挽输出；
 *    (2) 让它们上电后保持低电平（= 驱动芯片的"关断态"）；
 *    (3) 用板载 LED（PC13）做"心跳"，证明程序在跑。
 *
 *  为什么要先做这个：
 *    激励电路上电瞬间若控制线乱跳，可能误触发高压输出。所以第一课
 *    就把"上电保持关断"做对，这是安全底线，不是可选项。
 *
 *  涉及知识（见 docs/学习路线图.md 模块 1）：
 *    GPIO 模式、RCC 时钟使能、位操作。
 *
 *  你会用到的寄存器（查《RM0008 参考手册》第 9 章 GPIO）：
 *    RCC->APB2ENR     使能 GPIOA / GPIOC 时钟
 *    GPIOA->CRL       配置 PA0..PA7
 *    GPIOA->CRH       配置 PA8..PA15
 *    GPIOC->CRH       配置 PC8..PC15
 *    GPIOx->ODR       输出电平（读改写整端口）
 *    GPIOx->BSRR      原子置位/复位单独引脚（推荐）
 *
 *  关键提示：
 *    - 每个引脚在 CRL/CRH 中占 4 个位：MODE[1:0] + CNF[1:0]
 *    - 推挽输出 50MHz = MODE=11 + CNF=00
 *    - "先开时钟，再配引脚"，顺序错了引脚不会有任何反应
 *
 *  验收标准：
 *    - 编译 0 错误；
 *    - PC13 上的 LED 周期性闪烁；
 *    - 用万用表/示波器测 PA0..PA3，初始为低电平。
 * ========================================================================== */

#include "stm32f10x.h"

#define LED_PIN   13U   /* 板载 LED 接在 PC13 */

/* ---------------------------------------------------------------------------
 *  思考题 A：PC13 属于 CRL 还是 CRH？为什么？//CRH,因为CRH是配置PC8~PC15的寄存器
 *  思考题 B：如果忘了使能 GPIOA 时钟，写 GPIOA->CRL 会怎样？//不会有任何反应，寄存器写入无效
 *  （先想一想，再往下看 TODO）
 * ------------------------------------------------------------------------- */

static void gpio_init(void)
{
    /* ===== TODO 1-1：使能 GPIOA 和 GPIOC 的时钟 =====
     * 提示：RCC->APB2ENR 中 IOPAEN 在第 2 位、IOPCEN 在第 4 位。
     *       用"或等于"( |= ) 置位，千万不要用赋值(=)，
     *       否则会把别的外设时钟使能位清掉。
     */
    /* 在这里写下你的代码： */
    RCC->APB2ENR |= (1<<2) | (1<<4);

    /* ===== TODO 1-2：把 PA0 / PA1 / PA2 / PA3 配成推挽输出 50MHz =====
     * 提示：CRL 的低 16 位正好对应 PA0..PA3（每个引脚 4 位）。
     *       做法之一：先把这 16 位清零，再写入目标值。
     *       想一想：为什么要"先清零再写"，而不是直接或？//使用或会叠加原有配置和新配置,可能导致引脚配置错误
     */
    /* 在这里写下你的代码： */
    GPIOA->CRL &= ~0xFFFF;//使用&+~安全清零
    GPIOA->CRL |= 0x3333;//这里是怎么计算出这个十六进制数的？
    /* ↑【回答】推挽输出 50MHz 的 4 位值是 0b0011（CNF=00, MODE=11）。
     *   PA0~PA3 每个引脚各占 4 位，都填 0011：
     *       PA0 → bit3:0   = 0011
     *       PA1 → bit7:4   = 0011
     *       PA2 → bit11:8  = 0011
     *       PA3 → bit15:12 = 0011
     *   拼起来 = 0011 0011 0011 0011（二进制）= 0x3333（十六进制）。
     *   小技巧：4 位二进制正好 = 1 位十六进制，0b0011 = 0x3，
     *           4 个引脚就是 0x3 重复 4 次 → 0x3333。
     */

    /* ===== TODO 1-3：把 PC13 配成推挽输出 =====
     * 提示：PC13 在 PC8..PC15 区间里，注意它对应 CRH 的哪 4 位。
     *       别配到 CRL 去了（那是 PC0..PC7）。
     */
    /* 在这里写下你的代码： */
    GPIOC->CRH &= ~(0xF << 20);//这里为什么要左移20位？
    /* ↑【回答】CRH 管的是 PC8~PC15，每个引脚占 4 位。引脚在寄存器里的
     *   起始位 = (引脚号 - 8) × 4。
     *   PC13 → (13-8)×4 = 20，所以它占 bit23:20；
     *   掩码 0xF 必须左移 20 位才能"对准"PC13 那 4 位，再取反清零。
     *   （如果是 PC8，就是 (8-8)×4=0，不用移；PC15 则是 (15-8)×4=28。）
     * 
     * ⚠【BUG-1】这里只"清零"了，还没"写入模式值"！
     *   清 0 之后 MODE=00、CNF=00，PC13 变成了"输入模式"，
     *   即使后面翻转 ODR，引脚也没有输出能力 → LED 不会亮。
     *   请照着 TODO 1-2 的写法补一句，把 0x3 写到 bit23:20。*/
    GPIOC->CRH |= (0x3 <<20);
}

int main(void)
{
    gpio_init();

    /* ===== TODO 1-4：让 PA0..PA3 输出低电平（关断态） =====
     * 提示：可以整端口写 ODR，或用 BSRR 的高 16 位分别复位。
     */
    /* 在这里写下你的代码： */
    GPIOA->ODR &=~(0xF);//这里的位运算又是如何得到的？
    /* ↑【回答 + 两处要改】
     *  (a) 语法：行尾少了一个分号 ; —— 会编译报错。
     *  (b) 掩码算错了：ODR 的 bit0~bit15 分别对应 Px0~Px15 的电平。
     *      要清 PA0~PA3（就是低 4 位），
     *      0000=~(1111)=~(0XF)
     *      掩码应该是 0xF，不是 0xF<<16：
     *          GPIOA->ODR &= ~0xFU;      // 把 bit3:0 清 0
     *      为什么 "<<16" 不对？因为"高 16 位代表复位某引脚"是 BSRR 的规则，
     *      ODR 没有这个偏移——ODR 的 bit n 就直接对应引脚 n。
     *      （BSRR 与 ODR 的这个区别，正是本 Lab 第 4 题的核心，容易混。）
     *  补充：上电复位后 ODR 本来就是 0，这句是"显式声明关断意图"，值得写。
     */

    uint32_t N = 1000000;
    while (1)
    {
        /* ===== TODO 1-5：让 PC13 闪烁（约每 0.5 秒翻转一次） =====
         * 提示：先用"忙等"循环做粗略延时即可：
         *          for (volatile uint32_t i = 0; i < N; i++) { }
         *       自己调整 N，让闪烁速度肉眼舒服（注意别闪太快/太慢）。
         *       注意：volatile 不能省，否则编译器可能把循环优化掉。
         */
        /* 在这里写下你的代码： */
        while(1)
        {
            for (volatile uint32_t i = 0; i < N; i++) 
            { 
                
            }
        GPIOC->ODR ^= (1U << LED_PIN);//BSRR只读不写,请用ODR;
        }
        /* ↑【回答 + 三个要改的地方】
         *  ① N 溢出：uint16_t 最大只能到 65535，写 1000000 会被截断。
         *     延时计数器请改用 uint32_t。
         *
         *  ② 用 BSRR ^= 做翻转是错的 —— 这是本段最关键的问题：
         *     BSRR 是"只写"寄存器，读回来恒为 0（不是引脚的真实电平）。
         *     所以 GPIOC->BSRR ^= (1<<13) 实际等价于"写入 (1<<13)"，
         *     而 BSRR 低 16 位写 1 表示"置位"→ 每次都把 PC13 拉高，
         *     LED 只会常亮/常灭，根本不会闪。
         *     想"翻转"要用 ODR（ODR 能读回真实电平再异或）：
         *         GPIOC->ODR ^= (1U << LED_PIN);
         *
         *  ③ 结构问题：翻转被写进了延时循环的循环体里，
         *     等于"一边数数一边翻了 100 万次"——既没有得到干净的延时，
         *     翻转又快得肉眼看不见。正确结构应是"先空转，再翻一次"：
         *         for (volatile uint32_t i = 0; i < N; i++) { }  // 只空转
         *         GPIOC->ODR ^= (1U << LED_PIN);                 // 才翻一次
         */



        /* ===== TODO 1-6（进阶）：让 PA0 每约 1 秒翻转一次 =====
         * 用示波器或万用表观察 PA0，反推你写的忙等延时大概是多少毫秒。
         * 这一步是为 Lab 2"用定时器替代忙等"做铺垫 —— 先体会忙等的粗糙。
         */
    }
}

/* ---------------------------------------------------------------------------
 *  完成本 Lab 后请回答（写在下面或记在笔记本上）：
 *   1) 为什么 GPIO 配置前必须使能对应外设时钟？
 *   不使能时钟默认不上电
 *   2) CRL 与 CRH 的分工是什么？PC13 为什么不在 CRL 里？
 *   CRL控制低字节,CRH控制高字节,PC13属于8-15的高字节
 *   3) 忙等延时的缺点是什么？如果主频从 72MHz 变成 36MHz，延时还准吗？
 *   忙等占用时钟资源,计时与主频紧密相关,且阻塞性活动会拖时间导致时间更不准
 *   4) 用 BSRR 和用 ODR 改引脚电平，有什么区别？（想想"读改写"的隐患）
 *   BSRR只控制单个引脚的电平,不需要获取其他引脚电平也能保证其他引脚电平不被修改
 * ------------------------------------------------------------------------- */

/* ===========================================================================
 *  【助手检查小结】—— 对照修改，改完可删掉本段
 * ===========================================================================
 *  做对的地方：
 *    ✔ 时钟使能写法正确（用 |=，(1<<2)|(1<<4) 正是 IOPAEN / IOPCEN）
 *    ✔ CRL 的"先清后写"两步走正确（~0xFFFF 清 PA0~PA3，0x3333 写值）
 *    ✔ 四个思考题全部答对（尤其第 4 题 BSRR vs ODR 的理解很准）
 *
 *  按严重程度，需要修改的地方：
 *    [BUG-1] PC13 只清了配置位、没写模式值 → 引脚停在输入态，LED 不亮
 *    [BUG-2] GPIOA->ODR 那行：缺分号 + 掩码应为 ~0xF（不是 ~(0xF<<16)）
 *    [BUG-3] 用 BSRR ^= 做翻转 → 方向错误；翻转要用 GPIOC->ODR ^=
 *    [BUG-4] uint16_t N = 1000000 溢出 → 改用 uint32_t
 *    [BUG-5] 翻转写在了延时循环体内 → 应移到循环外，只翻一次
 *
 *  实测编译反馈（用 Keil 批量编译本文件的结果）：
 *    error : 行尾缺分号 —— 就是 BUG-2 那一行（编译器提示 expected ';'）
 *    warning: uint16_t N = 1000000 —— 编译器明确警告
 *             "implicit conversion ... changes value from 1000000 to 16960"
 *    结果：1 Error + 1 Warning，无法生成 .axf
 *
 *  改完后的验收：
 *    - PC13 每约 0.5 秒翻转一次，LED 稳定闪烁；
 *    - 万用表测 PA0~PA3，上电即为 0V（关断态）。
 * =========================================================================== */
