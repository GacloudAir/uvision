/* ============================================================================
 *  S2 — 中断与 NVIC（LED + 按键版 · 参考实现）
 * ============================================================================
 *  文件：firmware/study/S2_NVIC/nvic_lab_led.c
 *
 *  为什么要另有一份：
 *    原 nvic_lab.c 靠"PA1 的高电平宽度"来表示 ISR 持续了多久 —— 那需要示波器。
 *    手上只有一颗 LED 和一个按键时，把**时间编码成节奏**就行：
 *
 *      · 慢闪  亮 200ms / 灭 200ms，重复 2 次（共 800ms，约 2.5Hz）
 *              = 低优先级中断 TIM3 正在执行 → "嗒——嗒——"，能数清
 *      · 快闪  亮  50ms / 灭  50ms，重复 5 次（共 500ms，约 10Hz）
 *              = 高优先级中断 EXTI0 正在执行 → "哒哒哒哒哒"，像蜂鸣
 *
 *    于是"抢占"变成一个肉眼可见的问题：
 *        按键之后，快闪是【插在慢闪中间】，还是【排在慢闪之后】？
 *      插在中间 = 抢占成立；排在后面 = 只能排队。
 *    ★ 人眼对"节奏切换"极其敏感，对 0.3µs 的时间差完全不敏感 ——
 *      所以这个办法反而比示波器更适合讲"抢占"，只是看不到纳秒。
 *
 *  ---------------------------------------------------------------------------
 *  ⚠ 工程里只能有一个 main()：用这份做实验时，请把原来的 nvic_lab.c
 *    从 Target 里排除（右键文件 → Options for File → 取消 Include in Target Build）。
 *    两个 .c 都参与编译会报 "multiply defined symbol main"。
 *
 *  实验步骤 / 现象记录表：见同目录《实验设计_LED与按键.md》
 *  ---------------------------------------------------------------------------
 *
 *  ===== 接线 =====
 *      PA0 ──── 按键 ──── GND      （PA0 内部上拉，不接外部电阻、不接 3.3V）
 *      板载 LED = PC13，低电平点亮，不用接线
 *
 *  ===== 本文件用到的三段新东西（比原版多） =====
 *    1) DWT->CYCCNT：Cortex-M3 内核里的 32 位**周期计数器**，72MHz 下 1 个数 = 13.9ns。
 *       有了它，delay_ms() 不用"数循环"猜，而是真的按周期数等 —— 这是本文件
 *       唯一比原版"高级"的地方，也顺手解决了"2,000,000 到底是多久"的问题。
 *    2) 出/进各清一次 EXTI->PR：按键抖动会在几 ms 内产生好几个下降沿，
 *       第二遍清就把它们一起吞掉（否则一次按键会看到 2~3 组快闪）。
 *    3) 中断里只写 BSRR/BRR，不碰 ODR 的其它位。
 * ========================================================================== */

#include "stm32f10x.h"

/* ------------------------------- 引脚 ------------------------------------- */
#define LED_PIN      13U    /* PC13，低电平点亮 */
#define KEY_PIN       0U    /* PA0，低电平有效（内部上拉） */

/* --------------------------- 节奏参数（毫秒） ------------------------------ */
#define SLOW_ON     200U    /* 慢闪：亮 */
#define SLOW_OFF    200U    /* 慢闪：灭 */
#define SLOW_TIMES    2U    /* 慢闪：次数  → 总 800ms */
#define FAST_ON      50U    /* 快闪：亮 */
#define FAST_OFF     50U    /* 快闪：灭 */
#define FAST_TIMES    5U    /* 快闪：次数  → 总 500ms */

#define TIM3_PERIOD_MS  1500U   /* TIM3 每 1.5s 来一次慢闪（800ms 闪 + 700ms 静默）*/

/* ------------------------- 给 Watch 窗口看的变量 --------------------------- */
/* volatile 是必须的：这些变量只在中断里改，编译器若发现"没人读"就会删掉。 */
volatile uint32_t g_tim3_enter  = 0;   /* TIM3 ISR 进来过几次 */
volatile uint32_t g_exti_enter  = 0;   /* 按键 ISR 进来过几次（验证消抖有没有生效）*/
volatile uint32_t g_exti_cycles = 0;   /* 上一次按键 ISR 花了多少个 CPU 周期 */

/* ============================================================================
 *  DWT 周期计数器 —— 本文件的"秒表"
 * ========================================================================== */
static void dwt_init(void)
{
    CoreDebug->DEMCR |= CoreDebug_DEMCR_TRCENA_Msk;   /* 打开跟踪单元的电源 */
    DWT->CYCCNT = 0;
    DWT->CTRL  |= DWT_CTRL_CYCCNTENA_Msk;             /* 让 CYCCNT 开始计数 */
}

/* 精确毫秒延时：靠数 CPU 周期，不靠"循环多少次"。
 * ★ 为什么用 (now - start) 而不是 (now > start + ticks)：
 *   CYCCNT 是 32 位，59.6s 就溢出归零；无符号减法在溢出时依然得到正确答案。 */
static void delay_ms(uint32_t ms)
{
    uint32_t start = DWT->CYCCNT;
    uint32_t ticks = ms * (SystemCoreClock / 1000U);   /* 72MHz → 72000 tick/ms */
    while ((DWT->CYCCNT - start) < ticks)
    {
        /* 空等 */
    }
}

/* ============================================================================
 *  GPIO：PA0 输入上拉 / PC13 推挽输出（2MHz）
 * ========================================================================== */
static void gpio_init(void)
{
    RCC->APB2ENR |= (1U << 2) | (1U << 4);              /* GPIOA + GPIOC */

    /* PA0：CNF=10（上下拉输入）、MODE=00 → 0x8 */
    GPIOA->CRL &= ~(0xFU << (KEY_PIN * 4));
    GPIOA->CRL |=  (0x8U << (KEY_PIN * 4));
    GPIOA->BSRR =  (1U << KEY_PIN);                     /* ODR=1 → 选"上拉" */

    /* PC13：CNF=00（通用推挽）、MODE=10（2MHz）→ 0x2
     * ★ PC13/14/15 在低功耗域，数据手册限定输出速度 2MHz，别写 0x3（50MHz） */
    GPIOC->CRH &= ~(0xFU << ((LED_PIN - 8U) * 4));
    GPIOC->CRH |=  (0x2U << ((LED_PIN - 8U) * 4));
    GPIOC->BSRR =  (1U << LED_PIN);                     /* 上电先灭 */
}

/* ============================================================================
 *  EXTI0：PA0 下降沿触发
 * ========================================================================== */
static void exti0_init(void)
{
    RCC->APB2ENR |= (1U << 0);                          /* AFIO 时钟，配 EXTI 必开 */

    AFIO->EXTICR[0] &= ~(0xFU << 0);                    /* 0000 = PA0 */

    EXTI->FTSR |= (1U << KEY_PIN);                      /* 下降沿触发 */
    EXTI->PR    =  (1U << KEY_PIN);                     /* 先清历史挂起：写 1 清 0 */
    EXTI->IMR  |=  (1U << KEY_PIN);                     /* 最后才开屏蔽位 */
}

/* ============================================================================
 *  TIM3：1.5s 更新中断（PSC=7199 → 10kHz；ARR=14999 → 1.5s）
 * ========================================================================== */
static void tim3_init(void)
{
    RCC->APB1ENR |= (1U << 1);                          /* TIM3 在 APB1 */

    TIM3->PSC = 7199U;                                  /* 72MHz / 7200 = 10kHz */
    TIM3->ARR = (TIM3_PERIOD_MS * 10U) - 1U;            /* 1 tick = 100µs */

    TIM3->EGR  = (1U << 0);                             /* UG：立即装载 PSC/ARR */
    TIM3->SR   = 0;                                     /* UG 顺带置了 UIF，清掉 */
    TIM3->DIER |= (1U << 0);                            /* ★ UIE 放在清 SR 之后 */
    TIM3->CR1  |= (1U << 0);                            /* CEN：开始计数 */
}

/* ============================================================================
 *  main
 * ========================================================================== */
int main(void)
{
    NVIC_SetPriorityGrouping(3);        /* PRIGROUP=3 → 抢占 4 位 / 子优先级 0 位 */

    dwt_init();                         /* ★ 必须最先，后面所有 delay 都靠它 */
    gpio_init();
    exti0_init();
    tim3_init();

    /* 所有中断的"门"集中在这里开，方便一眼看清谁高谁低 */
    NVIC_SetPriority(TIM3_IRQn,  5);    /* 低：等着被打断 */
    NVIC_SetPriority(EXTI0_IRQn, 0);    /* 高：能插队 */

    NVIC_ClearPendingIRQ(TIM3_IRQn);    /* 再保险一次（见文档"问题 14"） */
    NVIC_EnableIRQ(TIM3_IRQn);
    NVIC_EnableIRQ(EXTI0_IRQn);

    while (1)
    {
        /* 主循环空着。
         * ★ 想验证"中断霸占 CPU"的话，可以在这里让 LED 做第三套节奏
         *   （比如每 100ms 翻一次），然后观察：ISR 一长，这个节奏就乱。 */
    }
}

/* ============================================================================
 *  低优先级 ISR：慢闪 2 次（800ms）
 *  —— 这 800ms 就是"低优先级中断正在占用 CPU"的可视化窗口
 * ========================================================================== */
void TIM3_IRQHandler(void)
{
    if (TIM3->SR & (1U << 0))                   /* 先确认是不是更新中断 */
    {
        TIM3->SR = (uint16_t)~(1U << 0);        /* ★ 先清标志再干活：
                                                 *   TIMx_SR 是 rc_w0（写 0 清），
                                                 *   写在最后会把"ISR 期间新来的更新"一起清掉 → 丢事件 */
        g_tim3_enter++;

        for (uint8_t k = 0; k < SLOW_TIMES; k++)
        {
            GPIOC->BRR  = (1U << LED_PIN);      /* 亮 */
            delay_ms(SLOW_ON);
            GPIOC->BSRR = (1U << LED_PIN);      /* 灭 */
            delay_ms(SLOW_OFF);
        }
    }
}

/* ============================================================================
 *  高优先级 ISR：快闪 5 次（500ms）
 *  —— 按键按在慢闪期间时，它要么"插进去"，要么"排在后面"
 * ========================================================================== */
void EXTI0_IRQHandler(void)
{
    uint32_t t0;

    EXTI->PR = (1U << KEY_PIN);                 /* 写 1 清；不清就是中断风暴 */
    t0 = DWT->CYCCNT;
    g_exti_enter++;

    for (uint8_t k = 0; k < FAST_TIMES; k++)
    {
        GPIOC->BRR  = (1U << LED_PIN);
        delay_ms(FAST_ON);
        GPIOC->BSRR = (1U << LED_PIN);
        delay_ms(FAST_OFF);
    }

    g_exti_cycles = DWT->CYCCNT - t0;           /* 这个 ISR 一共花了多少周期 */

    /* ★ 最小消抖：按键在按下瞬间会抖出好几个下降沿，它们在这 500ms 里
     *   早就又把 PR 置起来了。退出前再清一次，就把这些"抖动边沿"一起吞掉。
     *   不写这一句的典型现象：按一下，LED 快闪 2~3 组，很难判断先后关系。
     *   （更正规的做法是处理期间把 EXTI->IMR 关掉，退出时再开——以后做产品再改。）*/
    EXTI->PR = (1U << KEY_PIN);
}

/* ============================================================================
 *  【实验留档】做完把现象写在这里，尤其是"和预期不一样"的部分
 * ============================================================================
 *  实验 1（分组3, TIM3=5, EXTI0=0）按键时机：__________
 *      现象：慢闪 __ 次 → 快闪 → 慢闪 __ 次      结论：抢占 ______
 *  实验 2（TIM3=0, EXTI0=5）现象：____________________  结论：______
 *  实验 3（分组改 7）      现象：____________________  结论：______
 *  实验 4（注释掉 PR 清）  现象：____________________  结论：______
 * ========================================================================== */
