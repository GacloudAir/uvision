/* ============================================================================
 *  Lab 4 — 四通道"边沿表"：复现论文图 6  ★ 本项目技术核心 ★
 * ============================================================================
 *  文件：firmware/labs/Lab4_EDGE_TABLE/lab4_edgetable.c
 *
 *  目标：
 *    用 TIM2 的 4 个通道，在 PA0/PA1/PA2/PA3 上产生图 6 的四路时序
 *    （SYNC / OE / PULSE / DAMP），让示波器上的四道波形与原图逐段吻合。
 *
 * ---------------------------------------------------------------------------
 *  图 6 一个"发射组"（用图 6 自带的"时钟节拍"记；1 节拍 = Sys_clk 半周期）：
 *
 *    节拍  0 : OE↑ , PULSE↑        ← 两路同时上升（本组起点）
 *    节拍  4 : PULSE↓ , DAMP↑      ← 两路同时（★图 6 里压在同一条虚线上）
 *    节拍  8 : OE↓ , DAMP↓         ← 两路同时，本组结束
 *    节拍 16 : 回到 0，开始下一组
 *    Trigger_out(SYNC)：比 OE↑ 提前 1 节拍上升；图 6 中拉高后保持（整段发射的起始标志）
 *
 *  一个周期（16 节拍）内的占空比：
 *    OE  高 8/16 = 50%    PULSE 高 4/16 = 25%    DAMP 高 4/16 = 25%
 *
 *  ⚠ 注意：OE 只高"半"个周期（节拍 0~8）；节拍 8~16 里 OE 是低电平，
 *    对应两次发射之间的间隔（图 6 为示意画法，真实间隔长度由 Lab5 决定）。
 *
 *  ★ 本工程标准参数（Lab4–6 统一，直接用）：
 *    f_cnt = 72MHz（**PSC = 0**，不分频）→ 1 tick = 13.9ns
 *    ARR = **287**（288 tick）→ 周期 = 4µs → 激励频率 **250kHz**
 *    换算：图 6 的 1 节拍 = 288 / 16 = **18 tick**，于是：
 *      OE↑ / PULSE↑      → tick **0**
 *      PULSE↓ / DAMP↑    → tick **72**
 *      OE↓ / DAMP↓       → tick **144**
 *      SYNC↑            → tick **270**（= 288 − 18，提前 1 节拍）
 *    脉宽：OE 高 144 tick（2µs）、PULSE / DAMP 高 72 tick（1µs）
 *    （改频率：保持 f_cnt=72MHz，按比例改 ARR 与各 CCR —— 详见 Lab6）
 *
 *  通道映射（建议，可自行调整）：
 *    PA0 = SYNC
 *    PA1 = OE
 *    PA2 = PULSE
 *    PA3 = DAMP
 * ---------------------------------------------------------------------------
 *
 *  ======================= 本 Lab 的核心难点 =======================
 *  ① 一个通道在 Toggle 模式下一圈只能翻转一次；但 OE 在一个组内要
 *     "先升后降"两次变化 → 单靠 Lab3 的套路做不出来。
 *  ② DAMP 的高电平夹在周期"中间"（tick 4~8），既不贴起点也不贴终点
 *     → 这会让"纯 PWM"方案直接卡住（详见下方【路线 A 的死穴】）。
 *  你必须先想清楚"用什么策略"，再动手。
 *
 *  给你两条候选路线，请自己选一条（或先各试一下）：
 *
 *  【路线 A：硬件 PWM + 相位】
 *    每个通道用 PWM 输出一段高电平（下面按标准参数 250kHz 的 tick 数）：
 *      OE    高 0 ~ 144 tick  → PWM 模式1（CNT<CCR 时高），CCR = 144
 *      PULSE 高 0 ~ 72  tick  → PWM 模式1，CCR = 72
 *      DAMP  高 72 ~ 144 tick → ???（见下面的死穴）
 *    → 优点：全程由硬件产生，边沿精确。
 *
 *    ★ 路线 A 的死穴（想通它，才算真懂 PWM）★
 *      一个定时器只有一条 CNT，PWM 只能做出"贴在周期两端"的窗口：
 *        PWM1（110）→ 窗口从周期起点开始：[0, CCR)
 *        PWM2（111）→ 窗口到周期终点结束：[CCR, ARR+1)
 *      · OE、PULSE 都从"组起点"开始 → PWM1 正好搞定；
 *      · 但 DAMP = [72,144)，夹在 288 tick 周期的正中间，两头都不靠
 *        → 单靠一个定时器的 PWM，做不出中间那段 DAMP！
 *      解决思路（任选其一）：
 *        ① 把定时器周期设成"组宽"(144 tick，即 OE 高那一段)，DAMP 就变成
 *           组内"结尾窗口" [CCR,144)，PWM2 成立；组与组的间隙另用第二个
 *           定时器/中断产生。
 *        ② 直接走路线 B（中断），任意时刻翻转，一劳永逸。
 *
 *  【路线 B：定时器中断 + 手动翻转 GPIO】
 *    让定时器以固定间隔（如每 72 tick = 1µs，即落在 tick 0/72/144）产生中断，
 *    在中断服务程序里按"时刻表"判断该翻哪些引脚。
 *    → 优点：直观，能任意时刻翻转，适合理解时序本质；
 *    → 难点/代价：翻转精度受中断延迟影响，需要评估够不够用。
 *
 *  请在下面写下你的选择与理由：
 *    我选择路线 ____ ，理由是：
    按照课题组要求,我有足够的时间尝试两种方案，所以先选B,精度不够再用A
 *    ____________________________________________________________
 *  =================================================================
 *
 *  涉及知识（见 docs/学习路线图.md 模块 2、3）。
 *
 *  你会用到的寄存器：
 *    RCC->APB1ENR   TIM2EN      （TIM2 在 APB1）
 *    RCC->APB2ENR   IOPAEN / AFIOEN（★ GPIOA 时钟！四个输出引脚 PA0~PA3 全靠它；
 *                                   若用到重映射还要 AFIO 时钟）
 *    TIM2->PSC / ARR            时基（决定周期）
 *    TIM2->CCMR1 / CCMR2        4 个通道的模式（PWM1/PWM2/Toggle）
 *    TIM2->CCR1..CCR4           4 个通道的比较值
 *    TIM2->CCER                 4 个通道的输出使能（CC1E..CC4E）
 *    TIM2->CR1                  使能计数器 CEN
 *    TIM2->DIER / SR / NVIC     仅"路线 B"需要（中断）
 *
 *  ===== 思考题 =====
 *  Q1：一个定时器有几个 CNT？几个 CCR？这解释了为什么"一个定时器能带
 *      4 路信号"，也解释了为什么它们"周期一定相同"。
 * 1,4
 *  Q2：标准参数 f_cnt = 72MHz（1 tick = 13.9ns）。4µs、2µs、0.5µs 各是多少 tick？
 *      ARR 至少该取多少？
 * 288,144,36,至少取287  （若改用 4MHz，就是 16/8/2/至少取15 —— 你上次算的那组）
 *  Q3：SYNC 要"提前 1 节拍"= 18 tick（0.25µs）拉高。若 f_cnt 降到 1MHz，
 *      这个提前量还能精确表达吗？这对你选计数频率有什么启发？
 * 1tich精度为1us,无法进行精确对齐
 *  Q4：路线 A 里，OE 的高电平只占"半周期"(144 tick)。若把定时器周期直接
 *      设成"组宽"(144 tick)，OE 会变成常高——这说明"组"与"周期"是什么关系？
 *      要怎么做才对？
 * 
 * ========================================================================== */

#include "stm32f10x.h"

/* ---------------------------------------------------------------------------
 *  通道映射（与上面说明一致，如要改，两处一起改）
 * ------------------------------------------------------------------------- */
#define CH_SYNC    1U   /* PA0 */
#define CH_OE      2U   /* PA1 */
#define CH_PULSE   3U   /* PA2 */
#define CH_DAMP    4U   /* PA3 */

/* ---------------------------------------------------------------------------
 *  时刻表：把"图 6 的每个边沿"翻译成"通道 + 计数点"。
 *
 *  下面是一张"空白表"，请你按 Q2 的换算结果填满：
 *    - 换算（标准参数 f_cnt = 72MHz）：250kHz 一个周期 = 288 tick，
 *      边沿落在 0 / 72 / 144，SYNC 落在 270
 *    - 一行 = 一个边沿；同一时刻的多路可写成多行
 * ------------------------------------------------------------------------- */
typedef struct {
    uint8_t  ch;        /* 通道号：CH_SYNC / CH_OE / CH_PULSE / CH_DAMP */
    uint16_t tick;      /* 该边沿发生的计数点 */
    uint8_t  level;     /* 期望电平：1=高, 0=低（帮你理清思路，实际由模式决定） */
} edge_t;

static const edge_t EDGE_TABLE[] = {
    /* 刚才还是空占位 { 0, 0, 0 }，现在按图 6 填满（锚点：tick 0 = OE↑ = PULSE↑）
     *
     *  ★ 这张表就是"波形的时间表"：改频率/改相位，本质就是改这里的数值。
     *    ISR 里目前是"按时刻写死"的（更快）；表在这里保留，用于对照与练习。 */
    { CH_SYNC,   0U, 0U },   /* SYNC ↓  上一组的同步脉冲到此结束 */
    { CH_OE,     0U, 1U },   /* OE    ↑ ┐ */
    { CH_PULSE,  0U, 1U },   /* PULSE ↑ ┘ 同时（组起点） */
    { CH_PULSE, 72U, 0U },   /* PULSE ↓ ┐ */
    { CH_DAMP,  72U, 1U },   /* DAMP  ↑ ┘ 同时（图 6 同一条虚线） */
    { CH_OE,   144U, 0U },   /* OE    ↓ ┐ */
    { CH_DAMP, 144U, 0U },   /* DAMP  ↓ ┘ 同时（组结束） */
    { CH_SYNC, 270U, 1U }    /* SYNC  ↑  比下一组 OE↑ 提前 1 节拍 = 18 tick */
};

#define EDGE_COUNT  (sizeof(EDGE_TABLE) / sizeof(EDGE_TABLE[0]))

/* ---------------------------------------------------------------------------
 *  timing_init：初始化 TIM2 四通道
 *    你要完成：时基、每个通道的模式、CCR、输出使能、启动。
 *    （具体用哪条路线、每个 CCR 填多少，都取决于你上面的设计选择）
 * ------------------------------------------------------------------------- */
static void timing_init(void)
{
    /* ===== TODO 4-1：使能 TIM2 时钟（APB1） ===== */
    /* 你的代码： */ 
    RCC->APB1ENR |= (1U << 0);
    RCC->APB2ENR |= (1U << 2);
    /* ===== TODO 4-2：把 PA0 / PA1 / PA2 / PA3 配成复用推挽输出 =====
     * 提示：4 个引脚都在 GPIOA->CRL 的低 16 位里。
     */
    /* 你的代码： */
    GPIOA->CRL &= ~(0xFFFFU << 0);   /* ← 补分号！清 PA0~PA3 的 16 个配置位 */
    GPIOA->CRL |=  (0x3333U << 0);   /* 0x3 = 通用推挽 50MHz —— 路线 B 正确 ✓
                                      *   （若改回路线 A 的 PWM：这里要换成 0xBBBB
                                      *     = 复用推挽，把引脚交给定时器） */


    /* ===== TODO 4-3：设置时基 PSC / ARR（用 Q2 的结论） ===== */
    /* 你的代码： */
    TIM2->PSC = 0;//分频次数1,即不分频,f_cnt=72MHz
    TIM2->ARR = 287;//溢出计数288,得出T=288/72M=4us
    /* ===== TODO 4-4：配置 4 个通道（路线 B：通道只当"定时闹钟"，不输出引脚）=====
     *
     *  ★ 这里有个特别容易混的点，你已经踩到一半了：
     *    路线 B 里 CH1~CH3 【不是】对应 SYNC/OE/PULSE！
     *    它们只是三个"闹钟"，分别在 CNT 走到某个值时叫一声（触发中断）；
     *    引脚电平由 ISR 用 BSRR/BRR 直接翻，跟"通道号"毫无关系。
     *
     *      CH1  CCR1 =  72  → tick 72  (PULSE↓, DAMP↑)
     *      CH2  CCR2 = 144  → tick 144 (OE↓, DAMP↓)
     *      CH3  CCR3 = 270  → tick 270 (SYNC↑)
     *      tick 0 不用通道，用"更新事件"(UIF)
     *
     *  OCxM 保持默认 000（冻结）就行 —— 我们只要"比较事件"，不要它驱动引脚。
     *  所以 CCMR 一个字都不用改，只要写三个 CCR。
     */
    /* 你的代码： */
    TIM2->CCR1 = 72;      /* 闹钟①：tick 72  */
    TIM2->CCR2 = 144;     /* 闹钟②：tick 144 */
    TIM2->CCR3 = 270;     /* 闹钟③：tick 270 */



    /* ===== TODO 4-5：使能 4 个通道输出（CCER 的 CC1E..CC4E） ===== */
    /* 你的代码： */
    /* 提示：CC1E=bit0、CC2E=bit4、CC3E=bit8、CC4E=bit12。
     *       路线 A（PWM）：一次开 CH1~CH3：TIM2->CCER |= (1U<<0)|(1U<<4)|(1U<<8);
     *
     *       ★ 路线 B：这里【不要】动 CCER（引脚由 GPIO 直控，不走复用），
     *         改成本行的两件事：
     *             TIM2->DIER |= (1U<<0)|(1U<<1)|(1U<<2)|(1U<<3);  // 开中断源
     *             NVIC_SetPriority(TIM2_IRQn, 0); NVIC_EnableIRQ(TIM2_IRQn); */

    /* UIE(bit0)=更新事件中断；CC1IE/CC2IE/CC3IE(bit1~3)=三个比较中断。
     * 对应 4 个时刻：CNT 溢出归零 / =72 / =144 / =270。
     * ★ 注意：这不是"PA0~PA3 的中断"——通道只当闹钟，引脚电平是 ISR 自己翻的。 */
    TIM2->DIER |= (1U<<0)|(1U<<1)|(1U<<2)|(1U<<3);
    NVIC_SetPriority(TIM2_IRQn, 0);// 设置抢占优先级为0
    NVIC_EnableIRQ(TIM2_IRQn);// 使能 TIM2 中断通道
    /* ===== TODO 4-6：启动计数器 ===== */
    /* 你的代码： */
    TIM2->CR1 |= (1U << 0);   /*← 这就是 CEN 位。忘开它，前面的配置全白搭。 */

    /* ★ 补掉一个"第一组"的坑（按你现在的版本会遇到）：
     *   CEN 刚开时 CNT=0，但"tick 0"的更新事件要等跑满 288 个 tick 才来。
     *   于是第一组里 OE/PULSE 不会被拉高，而 tick 72 的 DAMP↑ 照样执行 →
     *   示波器上电后会先冒出一个"孤立的 DAMP 脉冲"，很容易被误当成 bug。
     *   启动后手动补一次 tick 0 的动作，第一组就正常了： */
    GPIOA->BSRR = (1U << 1) | (1U << 2);      /* OE=1, PULSE=1 */

}

int main(void)
{
    timing_init();

    /* EDGE_TABLE 是"边沿表"的书面版本（ISR 里为求快，已按时刻写死，没直接用它）。
     * 这一句只是告诉编译器"这张表我要保留"，顺便消掉 unused 警告。 */
    (void)EDGE_TABLE;

    while (1)
    {
        /* 到此为止：示波器四通道分别接 PA0..PA3，
         * 对照 assets/时序图-图6-原始.png（或放大版）逐段核对。
         *
         * 若用"路线 B"，你还需要在这里或 ISR 中，
         * 按 EDGE_TABLE 在每个时刻翻转对应引脚。
         */
    }
}

/* ---------------------------------------------------------------------------
 *  （路线 B 才需要）中断服务函数骨架 —— 名字必须与启动文件一致
 * ------------------------------------------------------------------------- */
/* ===========================================================================
 *  路线 B 的中断服务函数 —— 按图 6 的边沿填好，可直接用
 *  引脚：PA0=SYNC   PA1=OE   PA2=PULSE   PA3=DAMP
 *
 *  4 个中断源对应 4 个时刻（SR 的 bit）：
 *      UIF   bit0 → tick 0   : OE↑, PULSE↑ , SYNC↓（结束上一组的同步脉冲）
 *      CC1IF bit1 → tick 72  : PULSE↓, DAMP↑
 *      CC2IF bit2 → tick 144 : OE↓ , DAMP↓
 *      CC3IF bit3 → tick 270 : SYNC↑
 *
 *  ISR 必须"越短越好"：只写 BSRR / BRR（一次 store 就翻完），不做任何运算。
 *  注：EDGE_TABLE 就是上面那 8 条边沿的"书面形式"；这里按时刻写死，
 *      更简单也更快。想练"表驱动"可以改成循环查表。
 * ========================================================================= */
void TIM2_IRQHandler(void)
{
    uint16_t sr = TIM2->SR;                       /* 一次读出所有标志 */

    if (sr & (1U << 0))                           /* tick 0 */
    {
        /* ★ 优化：一次写 BSRR 同时做"置高 PA1/PA2"和"复位 PA0"。
         *   BSRR 低 16 位 = 置高，高 16 位 = 复位（bit n+16 复位 PA n）。
         *   比 BRR + BSRR 两次写少 2 个周期，所以这三条边沿更"齐"。 */
        GPIOA->BSRR = (1U << 1) | (1U << 2) | (1U << 16);
    }
    if (sr & (1U << 1))                           /* tick 72 */
    {
        /* 同理合并成一次写：置高 PA3、复位 PA2。18 = 2 + 16（复位 PA2）。
         * 这条正是图 6 的"虚线"，对齐要求最高，所以更要一次写完。 */
        GPIOA->BSRR = (1U << 3) | (1U << 18);
    }
    if (sr & (1U << 2))                           /* tick 144 */
    {
        GPIOA->BRR  = (1U << 1) | (1U << 3);      /* OE=0, DAMP=0 */
    }
    if (sr & (1U << 3))                           /* tick 270 */
    {
        GPIOA->BSRR = (1U << 0);                  /* SYNC=1  */
    }

    TIM2->SR = 0;   /* 清全部标志（这几位是"写 0 才清"）。
                     * 更严谨的写法是"只清已处理的位"，例如 TIM2->SR = ~(1U << 1);
                     * 只清 CC1IF —— 避免把"ISR 执行期间刚置起的新标志"也清掉。
                     * 本 Lab 的 ISR 只有 ~0.3µs，不会漏事件，写 0 全清即可。 */
}

/* ---------------------------------------------------------------------------
 *  完成本 Lab 后请回答：
 *   1) 你选了哪条路线？为什么？另一条的主要缺点是什么？
 *   B中断,A的主要缺点是要使用两个计时器,时序精度可能不准,且不易理解
 *   ↑ 补正：这两条基本"说反了"——
 *     · 路线 A 的真正死穴是「**DAMP 是中间窗口 [72,144)，单定时器 PWM 做不出**」，
 *       不是"要使用两个定时器"（加第二个定时器恰恰是"救 A"的办法）；
 *     · "时序精度可能不准"是**路线 B** 的缺点（中断延迟 ~0.3µs），不是 A。
 *     正确对比：A = 纯硬件、精度高，但 DAMP 做不出（得加第二定时器）；
 *               B = 简单、四路都能落在 PA0~PA3，但四条边沿整体晚 ~0.3µs（相对关系仍对）。
 *   2) 四个通道"周期一定相同"，这对实现图 6 是帮助还是限制？
 *   以当前需求的时序图来说,将周期统一设置为8tick(sysclk的16周期)是可行的,因此可以视为一种帮助
 *   ↑ 补正：tick 数算错了 —— 一个周期 = 16 节拍 = **288 tick**（不是 8 tick）。
 *     而且这件事"帮助"和"限制"两面都有：
 *     · 帮助：图 6 四路本来就同周期（288 tick），一条 CNT + 三个比较值刚好够用；
 *     · 限制：想让某一路用别的周期（比如 DAMP 想拉长到 1/2 周期）就做不到 ——
 *       四个通道被迫共享同一条 CNT，这正是"某些时序必须上第二个定时器"的根因。
 *   3) 如果你的实现在示波器上发现某个边沿抖动较大，你会从哪里找原因？
 *   在实战测试后,我意识到除了代码,开发板本身和测量设备也是导致该问题的重要因素
 *   4) 把"发射组"和"发射间隔"分开看，本 Lab 只做了哪一部分？（Lab 5 做另一部分）
 *   本lab做的是发射组,提供完整的时序周期,但不能控制发射的次数和时机
 * ------------------------------------------------------------------------- */
